## boards/arm/famig/Kconfig.defconfig
```kconfig
if BOARD_FAMIG

config ZMK_KEYBOARD_NAME
    default "G30-3930"

if USB

config USB_NRFX
    default y

config USB_DEVICE_STACK
    default y

endif # USB

config BT_CTLR
    default BT

endif # BOARD_FAMIG
```
